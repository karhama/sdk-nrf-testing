## applications/nrf5340_audio/Kconfig.sysbuild
```kconfig
#
# Copyright (c) 2024 Nordic Semico nductor
#
# SPDX-License-Identifier: LicenseRef-Nordic-5-Clause
#

config NRF_DEFAULT_IPC_RADIO
	default y

source "${ZEPHYR_BASE}/share/sysbuild/Kconfig"
```
